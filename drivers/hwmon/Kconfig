## drivers/hwmon/Kconfig
```kconfig
#
# I2C Sensor chip drivers configuration
#

menu "Hardware Monitoring support"

config HWMON
	tristate "Hardware Monitoring support"
	default y
	help
	  Hardware monitoring devices let you monitor the hardware health
	  of a system. Most modern motherboards include such a device. It
	  can include temperature sensors, voltage sensors, fan speed
	  sensors and various additional features such as the ability to
	  control the speed of the fans.  If you want this support you
	  should say Y here and also to the specific driver(s) for your
	  sensors chip(s) below.

	  This support can also be built as a module.  If so, the module
	  will be called hwmon.

config HWMON_VID
	tristate
	default n

config SENSORS_ADM1026
	tristate "Analog Devices ADM1026 and compatibles"
	depends on HWMON && I2C && EXPERIMENTAL
	select HWMON_VID
	help
	  If you say yes here you get support for Analog Devices ADM1026
	  sensor chip.

	  This driver can also be built as a module.  If so, the module
	  will be called adm1026.

config SENSORS_LM87
	tristate "National Semiconductor LM87"
	depends on HWMON && I2C && EXPERIMENTAL
	select HWMON_VID
	help
	  If you say yes here you get support for National Semiconductor LM87
	  sensor chips.

	  This driver can also be built as a module.  If so, the module
	  will be called lm87.

config SENSORS_SMSC47B397
        tristate "SMSC LPC47B397-NC"
        depends on HWMON && I2C && EXPERIMENTAL
        select I2C_ISA
        help
          If you say yes here you get support for the SMSC LPC47B397-NC
          sensor chip.

          This driver can also be built as a module.  If so, the module
          will be called smsc47b397.

config HWMON_DEBUG_CHIP
	bool "Hardware Monitoring Chip debugging messages"
	depends on HWMON
	default n
	help
	  Say Y here if you want the I2C chip drivers to produce a bunch of
	  debug messages to the system log.  Select this if you are having
	  a problem with I2C support and want to see more of what is going
	  on.

endmenu
```

## drivers/infiniband/hw/ehca/Kconfig
```kconfig
config INFINIBAND_EHCA
       tristate "eHCA support"
       depends on IBMEBUS && INFINIBAND
       ---help---
       This is a low level device driver for the IBM
       GX based Host channel adapters (HCAs)
```

## drivers/infiniband/ulp/rds/Kconfig
```kconfig
config INFINIBAND_RDS
	tristate "Reliable Datagram Sockets"
	depends on INFINIBAND && INFINIBAND_IPOIB
	---help---
	  Support for Reliable Datagram Sockets (RDS).  This provides
          sockets semantics over InfiniBand via address family
          AF_INET_RDS (address family 30). 

config INFINIBAND_RDS_DEBUG
	bool "Reliable Datagram Sockets debugging"
	depends on INFINIBAND_RDS
	---help---
	  This option causes debugging code to be compiled into the
	  RDS driver.  The output can be controlled via the debug_level
	  module parameter.
```

## drivers/infiniband/ulp/sdp/Kconfig
```kconfig
config INFINIBAND_SDP
	tristate "Sockets Direct Protocol"
	depends on INFINIBAND && INFINIBAND_IPOIB
	---help---
	  Support for Sockets Direct Protocol (SDP).  This provides
          sockets semantics over InfiniBand via address family
          AF_INET_SDP (address family 26).  You can also LD_PRELOAD the
          libsdp library from <http://openib.org> to have standard
          sockets applications use SDP.

config INFINIBAND_SDP_DEBUG
	bool "Sockets Direct Protocol debugging"
	depends on INFINIBAND_SDP
	---help---
	  This option causes debugging code to be compiled into the
	  SDP driver.  The output can be controlled via the debug_level
	  module parameter.

config INFINIBAND_SDP_DEBUG_DATA
	bool "Sockets Direct Protocol data path debugging"
	depends on INFINIBAND_SDP_DEBUG
	---help---
	  This option causes debugging code in the data path to be
          compiled into the SDP driver, and will noticeably effect
          performance. The output can be controlled via the debug_level
	  module parameter.
```

## drivers/scsi/adp94xx/Kconfig
```kconfig
#
# adp94xx 2.5.x kernel configuration file.
#
# $Id: //depot/razor/linux/src/Kconfig#4 $
#
config SCSI_ADP94XX
	tristate "Adaptec AIC94xx SAS/SATA support"
	depends on PCI && SCSI
	help
	This driver supports all of Adaptec's 3Gb/s PCI-X
	based SAS/SATA controllers.
```

## drivers/scsi/iscsi_sfnet/Kconfig
```kconfig
config SCSI_ISCSI_SFNET
	tristate "Software iSCSI support"
	depends on SCSI && INET
	select SCSI_ISCSI_ATTRS
	select CRYPTO
	select CRYPTO_MD5
	select CRYPTO_CRC32C
	---help---
	To compile this driver as a module, choose M here: the
	module will be called iscsi_sfnet.

	The iSCSI Driver provides a host with the ability to access
	storage through an IP network. The driver uses the iSCSI
	protocol to transport SCSI requests and responses over an IP
	network between the host (the "initiator") and "targets".
	Architecturally, the iSCSI driver combines with the host's
	TCP/IP stack, network drivers, and Network Interface Card
	(NIC) to provide the same functions as a SCSI or a Fibre
	Channel (FC) adapter driver with a Host Bus Adapter (HBA).

	The userspace component needed to initialize the driver,
	documentation, and sample configuration files are in the
	iscsi-initiator-utils package. 

	More information on this driver can be found here:
	http://linux-iscsi.sourceforge.net
```

## drivers/scsi/sas/Kconfig
```kconfig
#
# Kernel configuration file for the SAS Class
#
# Copyright (C) 2005 Adaptec, Inc.  All rights reserved.
# Copyright (C) 2005 Luben Tuikov <luben_tuikov@adaptec.com>
#
# This file is licensed under GPLv2.
#
# This program is free software; you can redistribute it and/or
# modify it under the terms of the GNU General Public License as
# published by the Free Software Foundation; version 2 of the
# License.
#
# This program is distributed in the hope that it will be useful,
# but WITHOUT ANY WARRANTY; without even the implied warranty of
# MERCHANTABILITY or FITNESS FOR A PARTICULAR PURPOSE.  See the GNU
# General Public License for more details.
#
# You should have received a copy of the GNU General Public License
# along with this program; if not, write to the Free Software
# Foundation, Inc., 59 Temple Place, Suite 330, Boston, MA 02111-1307
# USA
#
# $Id: //depot/sas-class/Kconfig#6 $
#

config SAS_CLASS
	tristate "SAS Layer and Discovery"
	depends on SCSI
	help
		If you wish to use a SAS Low Level Device Driver (LLDD)
		say Y or M here.  Otherwise, say N.

		SAS LLDDs which can make use of the SAS Transport Layer
		are LLDDs who do not hide the transport in firmware.
		Such LLDDs expose the transport to a management layer.
		E.g. aic94xx SAS LLDD is such a LLDD.

config SAS_DEBUG
	bool "Compile the SAS Layer in debug mode"
	default y
	depends on SAS_CLASS
	help
		Compiles the SAS Layer in debug mode.  In debug mode, the
		SAS Layer prints diagnostic and debug messages.
```
